## dts/bindings/sixtron-adc.yaml
```yaml
# Copyright (c) 2024 CATIE
# SPDX-License-Identifier: Apache-2.0

description: |
    ADC channels exposed on sixtron connector.

    The sixtron connector layout provides a 4-pin Analog Input.
    This has analog input signals labeled from ADC1 to ADC4.

    This binding provides a nexus mapping for these pins.

compatible: "sixtron-adc"

include: [base.yaml]

properties:
  io-channel-map:
    type: compound
    required: true

  io-channel-map-mask:
    type: compound

  io-channel-map-pass-thru:
    type: compound

  "#io-channel-cells":
    type: int
    required: true
    description: Number of items to expect in an ADC specifier
```

## dts/bindings/sixtron-pwm.yaml
```yaml
# Copyright (c) 2024 CATIE
# SPDX-License-Identifier: Apache-2.0

description: |
    PWM pins exposed on 6TRON connector.

    The sixtron connector layout provides a 3-pin PWM Output.
    This has output signals labeled from PWM1 to PWM3.

compatible: "sixtron-pwm"

include: [base.yaml]

properties:
  pwm-map:
    type: compound
    required: true

  pwm-map-mask:
    type: compound

  pwm-map-pass-thru:
    type: compound

  "#pwm-cells":
    type: int
    required: true
    description: Number of items to expect in a PWM specifier
```
